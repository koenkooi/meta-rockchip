## conf/machine/geekbox.conf
```bitbake
# Copyright (C) 2016 Romain Perier
# Released under the MIT license (see COPYING.MIT for the terms)

#@TYPE: Machine
#@NAME: Geekbox
#@DESCRIPTION: An high performance octa core tv box, based on RK3368.
#http://www.geekbox.tv

include conf/machine/include/rk3368.inc
KERNEL_DEVICETREE = "rk3368-geekbox.dts"
```

## conf/machine/include/rk3328.inc
```bitbake
SOC_FAMILY = "rk3328"

require conf/machine/include/arm/arch-arm64.inc
require conf/machine/include/soc-family.inc
require conf/machine/include/rockchip-defaults.inc

KERNEL_IMAGETYPE = "Image"
SERIAL_CONSOLES = "115200;ttyS2"

PREFERRED_PROVIDER_virtual/bootloader ?= "u-boot-rock64"
SPL_BINARY ?= "u-boot-spl-dtb.bin"

IMAGE_FSTYPES = "rockchip-gpt-img"
IMAGE_CLASSES += "rockchip-gpt-img"
```

## conf/machine/include/rk3368.inc
```bitbake
# Copyright (C) 2016 Romain Perier
# Released under the MIT license (see COPYING.MIT for the terms)

require conf/machine/include/arm/arch-armv8.inc

DEFAULTTUNE="aarch64"
PREFERRED_PROVIDER_virtual/kernel = "linux-dummy"
SERIAL_CONSOLES = "115200;ttyS2"
KERNEL_IMAGETYPE = "Image"
KBUILD_DEFCONFIG = "defconfig"
```
